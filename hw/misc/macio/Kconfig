## hw/misc/macio/Kconfig
```kconfig
config CUDA
    bool

config MAC_PMU
    bool

config MAC_DBDMA
    bool

config MACIO_GPIO
    bool

config MAC_K2_SOUND
    bool
    select I2C
    select MAC_DBDMA
```
